## components/kobentovg/Kconfig
```kconfig
menu "RemoteCompose ThorVG renderer"

config KOBENTOVG_3D
    bool "3D operations (software rasterizer)"
    default y
    help
        Draw RemoteCompose's 3D operations (meshes, cameras, lights) with rccore's software
        rasterizer. It needs two full-screen buffers plus a snapshot per run of meshes, and
        it is slow on small chips. When off, 3D operations are skipped and documents/3d/ is
        not embedded.

endmenu
```

## components/rcstage/Kconfig
```kconfig
menu "RemoteCompose stage"

    config RCSTAGE_TIMEZONE
        string "Time zone (POSIX TZ)"
        default "PST8PDT,M3.2.0,M11.1.0"
        help
            The local time zone for documents that show the time, as a POSIX TZ string,
            e.g. "PST8PDT,M3.2.0,M11.1.0" (US Pacific), "GMT0BST,M3.5.0/1,M10.5.0" (UK),
            "UTC0".

    config RCSTAGE_NTP_SERVER
        string "NTP server"
        default "pool.ntp.org"
        help
            Where the clock is set from (SNTP), once Wi-Fi has an address. Empty: never.

endmenu
```

## esp32/boards/m5stack_core2/components/board/Kconfig
```kconfig
menu "M5Stack Core2"

config CORE2_ROTATE_180
    bool "Turn the screen and touch 180 degrees"
    default n
    help
        Off: M5Stack's standard orientation (MADCTL 0x08, touch as reported), with the
        touch strip for the three buttons below the screen. On: the device held the other
        way up, picture and touch turned together.

endmenu
```

## esp32/firmware/rcplayer/main/Kconfig.projbuild
```kconfig
menu "RC player"

config RCPLAYER_DOCUMENTS
    string "Embedded documents (names, space-separated; empty: all)"
    default ""
    help
        Only these documents are built in, in this order (the first is shown at start).
        Names are looked up in documents/, documents/fit/ and documents/3d/. Empty: every
        document in documents/ and documents/fit/ (and documents/3d/ when 3D is on).

endmenu
```
